## sdkconfig.defaults
```kconfig
# CPU / Memory
CONFIG_FREERTOS_HZ=1000
CONFIG_ESP_DEFAULT_CPU_FREQ_MHZ_240=y
CONFIG_SPIRAM=y
CONFIG_SPIRAM_MODE_OCT=y
CONFIG_SPIRAM_SPEED_80M=y
CONFIG_COMPILER_OPTIMIZATION_PERF=y

# TinyUSB — composite device
CONFIG_TINYUSB=y
CONFIG_TINYUSB_ENABLED=y
CONFIG_TINYUSB_CDC_ENABLED=y
CONFIG_TINYUSB_CDC_COUNT=1
CONFIG_TINYUSB_HID_ENABLED=y
CONFIG_TINYUSB_HID_COUNT=2
CONFIG_TINYUSB_MSC_ENABLED=n
CONFIG_TINYUSB_DFU_MODE_NONE=y
CONFIG_TINYUSB_NET_MODE_NONE=y

# TinyUSB descriptor
CONFIG_TINYUSB_DESC_CUSTOM_VID=0x303A
CONFIG_TINYUSB_DESC_CUSTOM_PID=0x80D1
CONFIG_TINYUSB_DESC_MANUFACTURER_STRING="ODA"
CONFIG_TINYUSB_DESC_PRODUCT_STRING="ODA HID Bridge"
CONFIG_TINYUSB_DESC_SERIAL_STRING="0001"
CONFIG_TINYUSB_DESC_BCD_DEVICE=0x0100

# TinyUSB runtime
CONFIG_TINYUSB_TASK_PRIORITY=5
CONFIG_TINYUSB_TASK_STACK_SIZE=4096

# USB OTG
CONFIG_USB_OTG_SUPPORT_DEVICE=y

# 禁用 USB Serial/JTAG (与 TinyUSB 共享 GPIO19/20，不能同时使用)
CONFIG_USJ_ENABLE_USB_SERIAL_JTAG=n

# Flash
CONFIG_ESPTOOLPY_FLASHSIZE_16MB=y

# Partition table — use custom partitions.csv (not single_app defaults)
CONFIG_PARTITION_TABLE_CUSTOM=y
CONFIG_PARTITION_TABLE_CUSTOM_FILENAME="partitions.csv"

# Watchdog — relaxed during development
CONFIG_ESP_TASK_WDT_TIMEOUT_S=60
```
